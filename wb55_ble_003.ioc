# file: wb55_ble_003.ioc
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Mcu.Family=STM32WB
Mcu.Name=STM32WB55RGVx
Mcu.Package=VFQFPN68
NVIC.EXTI0_IRQn=true\:0\:0\:false\:false\:true\:false\:true\:true
NVIC.EXTI1_IRQn=true\:0\:0\:false\:false\:true\:false\:true\:true
NVIC.EXTI4_IRQn=true\:0\:0\:false\:false\:true\:false\:true\:true
NVIC.HSEM_IRQn=true\:0\:0\:false\:false\:true\:false\:true\:true
NVIC.IPCC_C1_RX_IRQn=true\:0\:0\:false\:false\:true\:true\:true\:true
NVIC.IPCC_C1_TX_IRQn=true\:0\:0\:false\:false\:true\:true\:true\:true
NVIC.PriorityGroup=NVIC_PRIORITYGROUP_4
OSC_IN.GPIO_Label=RCC_OSC_IN
OSC_IN.Mode=HSE-External-Oscillator
OSC_IN.Signal=RCC_OSC_IN
OSC_OUT.GPIO_Label=RCC_OSC_OUT
OSC_OUT.Mode=HSE-External-Oscillator
OSC_OUT.Signal=RCC_OSC_OUT
P-NUCLEO-WB55-NUCLEO.BUTTON=1
P-NUCLEO-WB55-NUCLEO.BUTTON2=1
P-NUCLEO-WB55-NUCLEO.BUTTON3=1
P-NUCLEO-WB55-NUCLEO.LD1=true
P-NUCLEO-WB55-NUCLEO.LD2=true
P-NUCLEO-WB55-NUCLEO.LD3=true
P-NUCLEO-WB55-NUCLEO.VCP=false
PA11.GPIO_Label=USB_DM
PA11.Signal=USB_DM
PA12.GPIO_Label=USB_DP
PA12.Signal=USB_DP
PA13.GPIO_Label=JTMS
PA13.Signal=SYS_JTMS-SWDIO
PA14.GPIO_Label=JTCK
PA14.Signal=SYS_JTCK-SWCLK
PB3.GPIO_Label=JTDO
PB3.Signal=SYS_JTDO-SWO
PC13.GPIO_Label=SYS_WKUP2
PC13.Signal=SYS_WKUP2
PC14-OSC32_IN.GPIO_Label=RCC_OSC32_IN
PC14-OSC32_IN.Mode=LSE-External-Oscillator
PC14-OSC32_IN.Signal=RCC_OSC32_IN
PC15-OSC32_OUT.GPIO_Label=RCC_OSC32_OUT
PC15-OSC32_OUT.Mode=LSE-External-Oscillator
PC15-OSC32_OUT.Signal=RCC_OSC32_OUT
PC2.GPIO_Label=Motor_Signal
PC2.Signal=GPIO_Output
ProjectManager.HeapSize=0x200
ProjectManager.StackSize=0x400
ProjectManager.TargetToolchain=STM32CubeIDE
RCC.ADCFreq_Value=128000000
RCC.AHBFreq_Value=32000000
RCC.APB1Freq_Value=32000000
RCC.APB1TimFreq_Value=32000000
RCC.APB2Freq_Value=32000000
RCC.APB2TimFreq_Value=32000000
RCC.APB3Freq_Value=16000000
RCC.CortexFreq_Value=32000000
RCC.HCLKFreq_Value=32000000
RCC.HSE_VALUE=32000000
RCC.HSI48_VALUE=48000000
RCC.HSI_VALUE=16000000
RCC.MSIClockRange=RCC_MSIRANGE_10
RCC.RFWKPClockSelection=RCC_RFWKPCLKSOURCE_LSE
RCC.RTCClockSelection=RCC_RTCCLKSOURCE_LSE
RCC.SMPSCLockSelection=RCC_SMPSCLKSOURCE_HSI
RCC.SMPSCLockSelectionVirtual=RCC_SMPSCLKSOURCE_HSI
RCC.SMPSCLockSelectionVirtualVirtual=RCC_SMPSCLKSOURCE_HSI
RCC.SMPSDivider=1
RCC.SYSCLKFreq_VALUE=32000000
RCC.USBFreq_Value=128000000
RCC.VCOOutputFreq_Value=256000000
RF1.Mode=RF1_Activate
RF1.Signal=RF_RF1
STM32_WPAN.AD_TYPE_COMPLETE_LOCAL_NAME=MT-STM32
STM32_WPAN.CFG_GAP_DEVICE_NAME=MGT-ST
STM32_WPAN.CFG_GAP_DEVICE_NAME_LENGTH=6
STM32_WPAN.CUSTOM_P2P_SERVER=Disabled
STM32_WPAN.CUSTOM_TEMPLATE=Enabled
STM32_WPAN.GAP_PERIPHERAL_ROLE=1
STM32_WPAN.INCLUDE_AD_TYPE_COMPLETE_LOCAL_NAME=1
STM32_WPAN.NUMBER_OF_SERVICES=1
STM32_WPAN.SERVICE1_CHAR1_GATT_NOTIFY_READ_REQ_AND_WAIT_FOR_APPL_RESP=\ 
STM32_WPAN.SERVICE1_CHAR1_GATT_NOTIFY_WRITE_REQ_AND_WAIT_FOR_APPL_RESP=\ 
STM32_WPAN.SERVICE1_CHAR1_LONG_NAME=RX
STM32_WPAN.SERVICE1_CHAR1_PROP_WRITE_WITHOUT_RESP=CHAR_PROP_WRITE_WITHOUT_RESP
STM32_WPAN.SERVICE1_CHAR1_SHORT_NAME=RX
STM32_WPAN.SERVICE1_CHAR1_UUID=77 77
STM32_WPAN.SERVICE1_CHAR1_VALUE_LENGTH=10
STM32_WPAN.SERVICE1_LONG_NAME=MT_SRV
STM32_WPAN.SERVICE1_SHORT_NAME=MT_SRV
STM32_WPAN.SERVICE1_UUID=99 99
VP_CRC_VS_CRC.Mode=CRC_Activate
VP_HSEM_VS_HSEM.Mode=HSEM_Activate
VP_IPCC_VS_IPCC.Mode=IPCC_Activate
VP_MEMORYMAP_VS_MEMORYMAP.Mode=CurAppReg
VP_P-NUCLEO-WB55-NUCLEO_VS_BSP_COMMON.Mode=COMMON
VP_RTC_VS_RTC_Activate.Mode=RTC_Enabled
VP_RTC_VS_RTC_WakeUp_intern.Mode=WakeUp
VP_SEQUENCER_VS_SEQUENCER.Mode=SEQUENCER_Enabled
VP_STM32_WPAN_VS_BLE_HOST.Mode=STM32_WPAN_Enabled
VP_TINY_LPM_VS_TINY_LPM.Mode=TINY_LPM_Enabled
board=P-NUCLEO-WB55-NUCLEO

// file: Core/Src/main.c
/* USER CODE BEGIN Header */
/**
  ******************************************************************************
  * @file           : main.c
  * @brief          : Main program body
  ******************************************************************************
  * @attention
  *
  * Copyright (c) 2026 STMicroelectronics.
  * All rights reserved.
  *
  * This software is licensed under terms that can be found in the LICENSE file
  * in the root directory of this software component.
  * If no LICENSE file comes with this software, it is provided AS-IS.
  *
  ******************************************************************************
  */
/* USER CODE END Header */
#include "main.h"
#include "crc.h"
#include "ipcc.h"
#include "rf.h"
#include "rtc.h"
#include "gpio.h"

/* USER CODE BEGIN Includes */
#include "custom_app.h"
#include "stm32_seq.h"
#include "app_conf.h"
#include "command_manager.h"
/* USER CODE END Includes */

void SystemClock_Config(void);
void PeriphCommonClock_Config(void);
/* USER CODE BEGIN PFP */
static void My_Main_Processing_Task(void);
/* USER CODE END PFP */

int main(void)
{

  /* MCU Configuration--------------------------------------------------------*/

  /* Reset of all peripherals, Initializes the Flash interface and the Systick. */
  HAL_Init();
  /* Config code for STM32_WPAN (HSE Tuning must be done before system clock configuration) */
  MX_APPE_Config();

  /* Configure the system clock */
  SystemClock_Config();

  /* Configure the peripherals common clocks */
  PeriphCommonClock_Config();

  /* IPCC initialisation */
  MX_IPCC_Init();

  /* Initialize all configured peripherals */
  MX_GPIO_Init();
  MX_CRC_Init();
  MX_RTC_Init();
  MX_RF_Init();

  /* Init code for STM32_WPAN */
  MX_APPE_Init();

  /* Initialize leds */
  BSP_LED_Init(LED_BLUE);
  BSP_LED_Init(LED_GREEN);
  BSP_LED_Init(LED_RED);

  /* Initialize USER push-button, will be used to trigger an interrupt each time it's pressed.*/
  BSP_PB_Init(BUTTON_SW1, BUTTON_MODE_EXTI);
  BSP_PB_Init(BUTTON_SW2, BUTTON_MODE_EXTI);
  BSP_PB_Init(BUTTON_SW3, BUTTON_MODE_EXTI);

  /* Infinite loop */
  /* USER CODE BEGIN WHILE */
  UTIL_SEQ_RegTask(1 << CFG_TASK_PROCESS_RX_DATA_ID, UTIL_SEQ_RFU, My_Main_Processing_Task);

  while (1)
  {
	UTIL_SEQ_Run(~0);
    /* USER CODE END WHILE */
    MX_APPE_Process();

  }
}

void SystemClock_Config(void)
{
  RCC_OscInitTypeDef RCC_OscInitStruct = {0};
  RCC_ClkInitTypeDef RCC_ClkInitStruct = {0};

  /** Configure LSE Drive Capability
  */
  HAL_PWR_EnableBkUpAccess();
  __HAL_RCC_LSEDRIVE_CONFIG(RCC_LSEDRIVE_MEDIUMHIGH);

  /** Configure the main internal regulator output voltage
  */
  __HAL_PWR_VOLTAGESCALING_CONFIG(PWR_REGULATOR_VOLTAGE_SCALE1);

  /** Initializes the RCC Oscillators according to the specified parameters
  * in the RCC_OscInitTypeDef structure.
  */
  RCC_OscInitStruct.OscillatorType = RCC_OSCILLATORTYPE_HSI|RCC_OSCILLATORTYPE_HSE
                              |RCC_OSCILLATORTYPE_LSE|RCC_OSCILLATORTYPE_MSI;
  RCC_OscInitStruct.HSEState = RCC_HSE_ON;
  RCC_OscInitStruct.LSEState = RCC_LSE_ON;
  RCC_OscInitStruct.HSIState = RCC_HSI_ON;
  RCC_OscInitStruct.MSIState = RCC_MSI_ON;
  RCC_OscInitStruct.HSICalibrationValue = RCC_HSICALIBRATION_DEFAULT;
  RCC_OscInitStruct.MSICalibrationValue = RCC_MSICALIBRATION_DEFAULT;
  RCC_OscInitStruct.MSIClockRange = RCC_MSIRANGE_10;
  RCC_OscInitStruct.PLL.PLLState = RCC_PLL_NONE;
  if (HAL_RCC_OscConfig(&RCC_OscInitStruct) != HAL_OK)
  {
    Error_Handler();
  }

  /** Configure the SYSCLKSource, HCLK, PCLK1 and PCLK2 clocks dividers
  */
  RCC_ClkInitStruct.ClockType = RCC_CLOCKTYPE_HCLK4|RCC_CLOCKTYPE_HCLK2
                              |RCC_CLOCKTYPE_HCLK|RCC_CLOCKTYPE_SYSCLK
                              |RCC_CLOCKTYPE_PCLK1|RCC_CLOCKTYPE_PCLK2;
  RCC_ClkInitStruct.SYSCLKSource = RCC_SYSCLKSOURCE_MSI;
  RCC_ClkInitStruct.AHBCLKDivider = RCC_SYSCLK_DIV1;
  RCC_ClkInitStruct.APB1CLKDivider = RCC_HCLK_DIV1;
  RCC_ClkInitStruct.APB2CLKDivider = RCC_HCLK_DIV1;
  RCC_ClkInitStruct.AHBCLK2Divider = RCC_SYSCLK_DIV1;
  RCC_ClkInitStruct.AHBCLK4Divider = RCC_SYSCLK_DIV1;

  if (HAL_RCC_ClockConfig(&RCC_ClkInitStruct, FLASH_LATENCY_1) != HAL_OK)
  {
    Error_Handler();
  }
}

void PeriphCommonClock_Config(void)
{
  RCC_PeriphCLKInitTypeDef PeriphClkInitStruct = {0};

  /** Initializes the peripherals clock
  */
  PeriphClkInitStruct.PeriphClockSelection = RCC_PERIPHCLK_SMPS|RCC_PERIPHCLK_RFWAKEUP;
  PeriphClkInitStruct.RFWakeUpClockSelection = RCC_RFWKPCLKSOURCE_LSE;
  PeriphClkInitStruct.SmpsClockSelection = RCC_SMPSCLKSOURCE_HSI;
  PeriphClkInitStruct.SmpsDivSelection = RCC_SMPSCLKDIV_RANGE0;

  if (HAL_RCCEx_PeriphCLKConfig(&PeriphClkInitStruct) != HAL_OK)
  {
    Error_Handler();
  }
}

/* USER CODE BEGIN 4 */
static void My_Main_Processing_Task(void)
{

    	uint8_t value = Custom_APP_Get_RxBuffer();
    	// TODO: change this to the command pattern so the switch isn't required
        switch (value) {
        case 10:
        	execute_command(CMD_OPTION_1);
        	break;
        case 20:
        	execute_command(CMD_OPTION_2);
        	break;
        case 30:
        	execute_command(CMD_OPTION_3);
        	break;
        case 40:
        	execute_command(CMD_OPTION_4);
        	break;
        default:
        	 // error state
        }
}
/* USER CODE END 4 */

void Error_Handler(void)
{
  __disable_irq();
  while (1)
  {
  }
}
